## drivers/char/csm-dp/Kconfig
```kconfig
menuconfig CSM_DP
	tristate "CSM DP Interface Core"
	depends on MHI_BUS
	default m
	help
	  CSM DP driver interface. The CSM DP character driver
	  provides a datapath server to user space.

if CSM_DP
config CSM_DP_TEST
	bool "CSM DP driver testing"
	depends on CSM_DP
	help
	  To enable the features in driver for testing.
endif # CSM_DP
```
